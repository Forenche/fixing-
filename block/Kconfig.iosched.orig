## block/Kconfig.iosched.orig
```kconfig
if BLOCK

menu "IO Schedulers"

config IOSCHED_NOOP
	bool "No-op I/O scheduler"
	default y
	---help---
	  The no-op I/O scheduler is a minimal scheduler that does basic merging
	  and sorting. Its main uses include non-disk based block devices like
	  memory devices, and specialised software or hardware environments
	  that do their own scheduling and require only minimal assistance from
	  the kernel.

config IOSCHED_DEADLINE
	tristate "Deadline I/O scheduler"
	default y
	---help---
	  The deadline I/O scheduler is simple and compact. It will provide
	  CSCAN service with FIFO expiration of requests, switching to
	  a new point in the service tree and doing a batch of IO from there
	  in case of expiry.

config IOSCHED_MAPLE
	tristate "Maple I/O scheduler"
	default y

config IOSCHED_TRIPNDROID
	tristate "TripNDroid IO Scheduler"
	default y
	---help---
	  The TripNDroid IO Scheduler is based on noop, deadline and vr
	  it uses deadlines to ensure some fairness. The scheduler is build
	  to keep a minimum overhead. It is mainly build for mobile devices.

config IOSCHED_CFQ
	tristate "CFQ I/O scheduler"
	default y
	---help---
	  The CFQ I/O scheduler tries to distribute bandwidth equally
	  among all processes in the system. It should provide a fair
	  and low latency working environment, suitable for both desktop
	  and server systems.

	  This is the default I/O scheduler.
	
config IOSCHED_DEPRESSION
	tristate "DEPRESSION I/O scheduler"
	default y

config IOSCHED_FIFO
	tristate "FIFO I/O scheduler"
	default y
	
config IOSCHED_FIOPS
	tristate "IOPS based I/O scheduler"
	default y
	---help---
	  This is an IOPS based I/O scheduler. It will try to distribute
          IOPS equally among all processes in the system. It's mainly for
          Flash based storage.

config IOSCHED_GOLD
	tristate "GOLD I/O scheduler"
	default y
	---help---
	  The GOLD I/O scheduler is an extremely GOLD scheduler,
	  based on GOLD, that relies on GOLD to
	  ensure fairness. The algorithm does not do any sorting but
	  basic merging, trying to keep a minimum overhead. It is aimed
	  mainly for aleatory access devices (eg: flash devices).

config IOSCHED_ANXIETY
	tristate "Anxiety I/O scheduler"
	default y
	---help---
	  The Anxiety I/O scheduler prioritizes latency over everything
	  else. It uses a simple algorithm that selects from FIFO queues
	  implemented as doubly linked lists and prioritizes reads over
	  writes.

config CFQ_GROUP_IOSCHED
	bool "CFQ Group Scheduling support"
	depends on IOSCHED_CFQ && BLK_CGROUP
	default n
	---help---
	  Enable group IO scheduling in CFQ.

config IOSCHED_BFQ
	tristate "BFQ I/O scheduler"
	default n
	---help---
	The BFQ I/O scheduler distributes bandwidth among all
	processes according to their weights, regardless of the
	device parameters and with any workload. It also guarantees
	a low latency to interactive and soft real-time applications.
	Details in Documentation/block/bfq-iosched.txt

config BFQ_GROUP_IOSCHED
	bool "BFQ hierarchical scheduling support"
	depends on IOSCHED_BFQ && BLK_CGROUP
	default n
	---help---

	Enable hierarchical scheduling in BFQ, using the blkio
	(cgroups-v1) or io (cgroups-v2) controller.

config IOSCHED_ZEN
	tristate "Zen I/O scheduler"
	default y
	---help---
	  FCFS, dispatches are back-inserted, deadlines ensure fairness.
	  Should work best with devices where there is no travel delay.
	
config IOSCHED_ROW
	tristate "ROW I/O scheduler"
	default y
	
	
config IOSCHED_SWITCHER
	bool "Use Noop while the screen is off"
	depends on IOSCHED_ANXIETY
	---help---
	  This enables a driver that switches the I/O scheduler for a single
	  block device to Noop when the screen turns off, and back to its
	  original I/O scheduler after a delay when the screen is turned back
	  on. It requires being manually initialized from a different driver
	  in order to grab the request_queue pointer that should have its I/O
	  scheduler switched to Noop when the screen turns off.


	
choice
	prompt "Default I/O scheduler"
	default DEFAULT_ZEN
	help
	  Select the I/O scheduler which will be used by default for all
	  block devices.

	config DEFAULT_DEADLINE
		bool "Deadline" if IOSCHED_DEADLINE=y

	config DEFAULT_TRIPNDROID
		bool "TD" if IOSCHED_TRIPNDROID=y
		
config DEFAULT_DEPRESSION
		bool "Depression" if IOSCHED_DEPRESSION=y
		
		config DEFAULT_FIFO
		bool "FIFO" if IOSCHED_FIFO=y
		
	config DEFAULT_CFQ
		bool "CFQ" if IOSCHED_CFQ=y

	config DEFAULT_BFQ
		bool "BFQ" if IOSCHED_BFQ=y
		help
		  Selects BFQ as the default I/O scheduler which will be
		  used by default for all block devices.
		  The BFQ I/O scheduler aims at distributing the bandwidth
		  as desired, independently of the disk parameters and with
		  any workload. It also tries to guarantee low latency to
		  interactive and soft real-time applications.

	config DEFAULT_NOOP
		bool "No-op"

	config DEFAULT_GOLD
		bool "GOLD" if IOSCHED_GOLD=y

	config DEFAULT_FIOPS
		bool "FIOPS" if IOSCHED_FIOPS=y

	config DEFAULT_ZEN
		bool "ZEN" if IOSCHED_ZEN=y

	config DEFAULT_MAPLE
		bool "Maple" if IOSCHED_MAPLE=y

	config DEFAULT_ANXIETY
		bool "Anxiety" if IOSCHED_ANXIETY=y
		
		config DEFAULT_ROW
		bool "ROW" if IOSCHED_ROW=y

	config DEFAULT_TRIPNDROID
		bool "TD" if IOSCHED_TRIPNDROID=y

	config DEFAULT_FIOPS
		bool "FIOPS" if IOSCHED_FIOPS=y

	config DEFAULT_SIO
		bool "SIO" if IOSCHED_SIO=y

endchoice

config DEFAULT_IOSCHED
	string
	default "deadline" if DEFAULT_DEADLINE
	default "anxiety" if DEFAULT_ANXIETY
	default "tripndroid" if DEFAULT_TRIPNDROID
	default "cfq" if DEFAULT_CFQ
	default "MQ_IOSCHED_DEADLINE" if DEFAULT_MQ_IOSCHED_DEADLINE
	default "MQ_IOSCHED_KYBER" if DEFAULT_MQ_IOSCHED_KYBER
	default "bfq" if DEFAULT_BFQ
	default "noop" if DEFAULT_NOOP
	default "fiops" if DEFAULT_FIOPS
	default "GOLD" if DEFAULT_GOLD
	default "zen" if DEFAULT_ZEN
	default "maple" if DEFAULT_MAPLE
	default "fifo" if DEFAULT_FIFO
	default "row" if DEFAULT_ROW
default "depression" if DEFAULT_DEPRESSION
endmenu

endif
```
